#include <Wire.h>
#include <Adafruit_GFX.h>
#include <Adafruit_SSD1306.h>

// Configurare display OLED
#define SCREEN_WIDTH 128
#define SCREEN_HEIGHT 64
#define OLED_RESET -1
#define SCREEN_ADDRESS 0x3C
Adafruit_SSD1306 display(SCREEN_WIDTH, SCREEN_HEIGHT, &Wire, OLED_RESET);

// Configurare pinii pentru senzor ultrasonic
#define TRIG_PIN 2
#define ECHO_PIN 3

float H_max = 6;  // Înălțimea maximă a lichidului în cm

// Configurare joystick
#define VRY_PIN A1                         // Pin pentru axa Y
#define SW_PIN 4                           // Pin pentru buton
int yValue = 0;                            // Valoare axa Y
int buttonState = 0;                       // Starea butonului
int menuCursor = 1;                        // Poziția în meniu (1 = prima opțiune)
const int maxMenuItemsMain = 3;            // Numărul total de opțiuni în meniul principal
const int maxMenuItemsDrinks = 4;          // Numărul de băuturi (include opțiunea Înapoi)
const int maxMenuItemsSizes = 4;           // Numărul de dimensiuni (include opțiunea Înapoi)
const int maxMenuItemsConfirm = 3;         // Numărul de opțiuni în confirmare (include opțiunea Înapoi)
const int maxMenuItemsSystemSettings = 3;  // Numărul de opțiuni în Setări sistem (inclus Verificare ultrasonic)

int currentPage = 0;    // Pagina curentă (0 = meniul principal, 1 = Selectare băutură, 2 = Selectare cantitate, 3 = Confirmare selecție, 4 = Setări sistem, 5 = Informații sistem)
int drinkCursor = 1;    // Poziția în lista de băuturi
int sizeCursor = 1;     // Poziția în lista de cantități
int confirmCursor = 1;  // Poziția în lista de confirmare


// Configurare pinii pentru L298N
const int IN1 = 5;   // Pin de control pentru motorul 1, direcția 1
const int IN2 = 6;   // Pin de control pentru motorul 1, direcția 2
const int IN3 = 11;  // Pin de control pentru motorul 2, direcția 1
const int IN4 = 10;  // Pin de control pentru motorul 2, direcția 2


// Configurare buzzer
bool buzzerHasPlayed = false;  // Variabilă pentru a controla dacă buzzer-ul a sunat

// 'logo (1)', 128x64px
const unsigned char epd_bitmap_logo__1_[] PROGMEM = {
  0xff, 0xff, 0xff, 0xff, 0xff, 0xff, 0xff, 0xff, 0xff, 0xff, 0xff, 0xff, 0xff, 0xff, 0xff, 0xff,
  0xff, 0xff, 0xff, 0xff, 0xff, 0xff, 0xff, 0xff, 0xff, 0xff, 0xff, 0xff, 0xff, 0xff, 0xff, 0xff,
  0xff, 0xff, 0xff, 0xff, 0xff, 0xff, 0xff, 0xff, 0xff, 0xff, 0xff, 0xff, 0xff, 0xff, 0xff, 0xff,
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  0xff, 0xff, 0xff, 0xff, 0xff, 0xff, 0xff, 0xff, 0xff, 0xff, 0xff, 0xff, 0xff, 0xff, 0xff, 0xff
};

// Functii Display
void showMainMenu() {
  display.setTextSize(1);
  display.setCursor(0, 0);
  display.println("Meniu Principal");
  display.println("---------------------");
  display.println(menuCursor == 1 ? "> Preparare bautura" : "  Preparare bautura");
  display.println(menuCursor == 2 ? "> Setari sistem" : "  Setari sistem");
  display.println(menuCursor == 3 ? "> Informatii sistem" : "  Informatii sistem");
}

void showSelectDrinkPage() {
  display.setTextSize(1);
  display.setCursor(0, 0);
  display.println("Selectare bautura");
  display.println("---------------------");
  display.println(drinkCursor == 1 ? "> Cafea" : "  Cafea");
  display.println(drinkCursor == 2 ? "> Ceai" : "  Ceai");
  display.println(drinkCursor == 3 ? "> Ciocolata calda" : "  Ciocolata calda");
  display.println(drinkCursor == maxMenuItemsDrinks ? "> Inapoi" : "  Inapoi");
}

void showSelectSizePage() {
  display.setTextSize(1);
  display.setCursor(0, 0);
  display.println("Selectare cantitate");
  display.println("---------------------");
  display.println(sizeCursor == 1 ? "> Mica" : "  Mica");
  display.println(sizeCursor == 2 ? "> Medie" : "  Medie");
  display.println(sizeCursor == 3 ? "> Mare" : "  Mare");
  display.println(sizeCursor == maxMenuItemsSizes ? "> Inapoi" : "  Inapoi");
}

void showConfirmationPage() {
  display.setTextSize(1);
  display.setCursor(0, 0);
  display.println("Confirmare selectie");
  display.println("---------------------");
  display.println(confirmCursor == 1 ? "> DA" : "  DA");
  display.println(confirmCursor == 2 ? "> NU" : "  NU");
  display.println(confirmCursor == maxMenuItemsConfirm ? "> Inapoi" : "  Inapoi");
}

void showSystemSettingsPage() {
  display.setTextSize(1);
  display.setCursor(0, 0);
  display.println("Setari Sistem");
  display.println("---------------------");
  display.println(menuCursor == 1 ? "> Verificare buzzer" : "  Verificare buzzer");
  display.println(menuCursor == 2 ? "> Nivel lichid" : "  Nivel lichid");
  display.println(menuCursor == maxMenuItemsSystemSettings ? "> Inapoi" : "  Inapoi");
}


void showLoadingBar() {
  display.clearDisplay();
  display.setTextSize(1);
  display.setCursor(0, 0);
  display.println("Preparare in curs...");
  display.display();

  for (int i = 0; i <= 100; i += 5) {
    display.fillRect(0, 20, (SCREEN_WIDTH * i) / 100, 10, SSD1306_WHITE);
    display.display();
    delay(250);  // Durata de încărcare: 5 secunde (20 * 250ms)
  }
}

void showSystemInfoPage() {
  display.setTextSize(1);
  display.setCursor(0, 0);
  display.println("Informatii Sistem");
}

void showBitmap(const uint8_t *bitmap) {

  display.clearDisplay();
  display.drawBitmap(0, 0, bitmap, SCREEN_WIDTH, SCREEN_HEIGHT, WHITE);
  display.display();
}


// Functii Buzzer
void setup_timer() {
  DDRB |= 1 << 1;    // Declară PB1 ca ieșire
  TCCR1A = 1 << 6;   // OC1A își va schimba valoarea când timer-ul ajunge la OCR1A
  TCCR1B = 1 << 3;   // Se activează modul CTC (Clear Timer on Compare Match)
  TCCR1B |= 1 << 0;  // Se pornește timer-ul cu prescaler = 1
  OCR1A = 22000;     // O iterație va dura 1,66 ms (cu prescaler de 1)
}

void testBuzzer() {
  setup_timer();
  DDRB |= (1 << DDB1);  // Setăm PB1 ca ieșire pentru buzzer (OC1A)

  TCCR1A |= (1 << COM1A0);  // Configurăm OC1A pentru toggle la comparare
  TCCR1B |= (1 << WGM12);   // Activăm modul CTC
  TCCR1B |= (1 << CS10);    // Setăm prescaler la 1

  OCR1A = 1000;  // Frecvența sunetului (aprox. 1kHz pentru un ton audibil)

  delay(1000);

  TCCR1A &= ~(1 << COM1A0);  // Dezactivăm toggle pe OC1A
  TCCR1B &= ~(1 << CS10);    // Oprim timer-ul

  buzzerHasPlayed = false;  // Resetăm flag-ul pentru următoarea activare
}

// Functii Senzor Ultrasonic
long measureDistance() {
  digitalWrite(TRIG_PIN, LOW);
  delayMicroseconds(2);
  digitalWrite(TRIG_PIN, HIGH);
  delayMicroseconds(10);
  digitalWrite(TRIG_PIN, LOW);

  long durata = pulseIn(ECHO_PIN, HIGH);
  float distanta = durata * 0.034 / 2;  // Conversie în centimetri
  return distanta;
}

void displayUltrasonicMeasurement() {
  display.clearDisplay();
  display.setTextSize(1);
  display.setCursor(0, 0);
  display.println(F("Verificare ultrasonic"));
  display.setCursor(0, 20);
  long distanta = measureDistance();
  float nivel = (1 - (distanta / H_max)) * 100;
  nivel = constrain(nivel, 0, 100);  // Limităm nivelul între 0% și 100%
  display.print(F("Nivel Lichid: "));
  display.print(nivel);
  display.println(F(" %"));
  display.display();

  if (nivel < 30) {
    testBuzzer();
  }

  delay(5000);
}


// Functii JoyStick Y
int readADC(uint8_t channel) {
  ADMUX = (ADMUX & 0xF8) | channel;  // Selectează canalul ADC
  ADCSRA |= (1 << ADSC);             // Pornește conversia
  while (ADCSRA & (1 << ADSC))
    ;          // Așteaptă să se termine conversia
  return ADC;  // Returnează valoarea citită
}

void handleJoystick() {
  yValue = readADC(1);  // Citim axa Y de la canalul 1 (A1)
  buttonState = digitalRead(SW_PIN);

  if (yValue < 400) {
    joystickUp();
  } else if (yValue > 600) {
    joystickDown();
  }

  if (buttonState == LOW) {
    joystickPressed();
  }
}

void joystickUp() {
  if (currentPage == 0) {
    menuCursor--;
    if (menuCursor < 1) menuCursor = maxMenuItemsMain;
  } else if (currentPage == 1) {
    drinkCursor--;
    if (drinkCursor < 1) drinkCursor = maxMenuItemsDrinks;
  } else if (currentPage == 2) {
    sizeCursor--;
    if (sizeCursor < 1) sizeCursor = maxMenuItemsSizes;
  } else if (currentPage == 3) {
    confirmCursor--;
    if (confirmCursor < 1) confirmCursor = maxMenuItemsConfirm;
  } else if (currentPage == 4) {
    menuCursor--;
    if (menuCursor < 1) menuCursor = maxMenuItemsSystemSettings;
  }
  delay(200);  // Debounce
}

void joystickDown() {
  if (currentPage == 0) {
    menuCursor++;
    if (menuCursor > maxMenuItemsMain) menuCursor = 1;
  } else if (currentPage == 1) {
    drinkCursor++;
    if (drinkCursor > maxMenuItemsDrinks) drinkCursor = 1;
  } else if (currentPage == 2) {
    sizeCursor++;
    if (sizeCursor > maxMenuItemsSizes) sizeCursor = 1;
  } else if (currentPage == 3) {
    confirmCursor++;
    if (confirmCursor > maxMenuItemsConfirm) confirmCursor = 1;
  } else if (currentPage == 4) {
    menuCursor++;
    if (menuCursor > maxMenuItemsSystemSettings) menuCursor = 1;
  }
  delay(200);  // Debounce
}

void joystickPressed() {
  if (currentPage == 0) {
    if (menuCursor == 1) {
      currentPage = 1;
      drinkCursor = 1;
    } else if (menuCursor == 2) {
      currentPage = 4;
    } else if (menuCursor == 3) {
      currentPage = 5;
    }
  } else if (currentPage == 1) {
    if (drinkCursor == maxMenuItemsDrinks) {
      currentPage = 0;
      menuCursor = 1;
    } else {
      currentPage = 2;
      sizeCursor = 1;
    }
  } else if (currentPage == 2) {
    if (sizeCursor == maxMenuItemsSizes) {
      currentPage = 1;
      drinkCursor = 1;
    } else {
      currentPage = 3;
      confirmCursor = 1;
    }
  } else if (currentPage == 3) {
    if (confirmCursor == maxMenuItemsConfirm) {
      currentPage = 2;
      sizeCursor = 1;
    } else if (confirmCursor == 1) {
      showLoadingBar();
      prepareDrink();
      currentPage = 0;
      menuCursor = 1;
    } else if (confirmCursor == 2) {
      currentPage = 1;
      drinkCursor = 1;
    }
  } else if (currentPage == 4) {
    if (menuCursor == 1) {
      testBuzzer();
    } else if (menuCursor == 2) {
      displayUltrasonicMeasurement();  // Afișează valoarea măsurată
    } else if (menuCursor == 3) {
      currentPage = 0;
      menuCursor = 1;
    }
  } else if (currentPage == 5) {
    currentPage = 0;
    menuCursor = 1;
  }
  delay(200);  // Debounce
}



// Functii Pompe
void prepareDrink() {
  // Activarea primei pompe
  PORTD |= (1 << PORTD5);   // Setează PD5 (IN1 HIGH)
  PORTD &= ~(1 << PORTD6);  // Setează PD6 (IN2 LOW)
  delay(5000);              // 5 secunde

  // Oprirea primei pompe
  PORTD &= ~(1 << PORTD5);  // Setează PD5 (IN1 LOW)
  PORTD &= ~(1 << PORTD6);  // Setează PD6 (IN2 LOW)
  delay(2000);              // 2 secunde

  // Activarea celei de-a doua pompe
  PORTB |= (1 << PORTB3);   // Setează PB3 (IN3 HIGH)
  PORTB &= ~(1 << PORTB2);  // Setează PB2 (IN4 LOW)
  delay(5000);              // 5 secunde

  // Oprirea celei de-a doua pompe
  PORTB &= ~(1 << PORTB3);  // Setează PB3 (IN3 LOW)
  PORTB &= ~(1 << PORTB2);  // Setează PB2 (IN4 LOW)
  delay(2000);              // 2 secunde

  testBuzzer();
}


void setup() {
  pinMode(SW_PIN, INPUT_PULLUP);

  // Setarea pinilor pentru senzorul ultrasonic
  pinMode(TRIG_PIN, OUTPUT);
  pinMode(ECHO_PIN, INPUT);

  // Configurare ADC (KY- JoyStick)
  ADMUX = (1 << REFS0);                                               // Setează referința de tensiune la AVcc
  ADCSRA = (1 << ADEN) | (1 << ADPS2) | (1 << ADPS1) | (1 << ADPS0);  // Activează ADC și setează prescaler-ul la 128

  // Setarea pinilor ca ieșiri
  // Portul D: Pin 5 (PD5), Pin 6 (PD6) -> PORTD
  // Portul B: Pin 11 (PB3), Pin 10 (PB2) -> PORTB
  DDRD |= (1 << DDD5) | (1 << DDD6);  // Setează PD5, PD6 ca ieșiri
  DDRB |= (1 << DDB2) | (1 << DDB3);  // Setează PB2, PB3 ca ieșiri

  display.begin(SSD1306_SWITCHCAPVCC, SCREEN_ADDRESS);
  display.clearDisplay();

  showBitmap(epd_bitmap_logo__1_);
  delay(2000);  // Afișează bitmap-ul timp de 2 secunde

  display.clearDisplay();
  display.setTextSize(2);          // Dimensiune text
  display.setTextColor(WHITE);     // Culoare text
  display.setCursor(15, 20);       // Pozitioneaza textul pe mijloc
  display.println(F("Welcome!"));  // Mesajul de afișat
  display.display();

  delay(3000);  // Așteaptă 3 secunde pentru afișarea mesajului

  display.setTextSize(1);
  display.setTextColor(SSD1306_WHITE);
  display.setCursor(0, 0);
  display.display();
}


void loop() {
  handleJoystick();

  display.clearDisplay();
  if (currentPage == 0) {
    showMainMenu();
  } else if (currentPage == 1) {
    showSelectDrinkPage();
  } else if (currentPage == 2) {
    showSelectSizePage();
  } else if (currentPage == 3) {
    showConfirmationPage();
  } else if (currentPage == 4) {
    showSystemSettingsPage();
  } else if (currentPage == 5) {
    showSystemInfoPage();
  }
  display.display();
}
